## Kconfig.projbuild
```kconfig
menu "Bosch BHI Motion Sensor"
    config BHI_MOTION_ACTIVE
        bool "Active"
        default y
    choice BHI_SENSOR_MODEL
        prompt "Sensor model"
        default BHI260AP
        depends on BHI_MOTION_ACTIVE
        config BHI260AP
            bool "BHI260AP"
        config BHI380
            bool "BHI380"
    endchoice
    config BHI_MOTION_ADDRESS
        hex
        prompt "Gyro/Accel BHI260AP Sensor Address"
        default 0x28
        depends on BHI_MOTION_ACTIVE
    config PIN_BHI_RESET
        int "Reset Pin"
        default 37
        depends on BHI_MOTION_ACTIVE
    config PIN_BHI_INTERRUPT
        int "Interrupt Pin"
        default 36
        depends on BHI_MOTION_ACTIVE
    choice BHI_OUTPUT_MODE
        prompt "Output Mode"
        default EULER
        depends on BHI_MOTION_ACTIVE
        config EULER
            bool "EULER"
        config QUATERNION
            bool "QUATERNION"
    endchoice
    choice BHI_FLASH_MODE
        prompt "Flash Mode"
        default BHI_USE_RAM
        depends on BHI_MOTION_ACTIVE
        config BHI_USE_RAM
            bool "RAM"
        config BHI_USE_FLASH
            bool "FLASH"
    endchoice
endmenu
```
